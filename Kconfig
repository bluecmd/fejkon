## Kconfig
```kconfig
mainmenu "Fejkon bitstream configuration"

config FEJKON
  bool
  # Always enabled features
  select SFP_PORTS
  default y

config HAVE_ETHERNET
  bool

config SFP_PORTS
  bool "SFP+ Ports"

# Port 0 is always enabled, and FC is the only supported option right now
choice PORT0
  bool "Port 0"
  default PORT0_FC
  depends on SFP_PORTS

config PORT0_FC
  bool "Fibre Channel"

endchoice

choice PORT1
  bool "Port 1"
  default PORT1_DISABLED
  depends on SFP_PORTS

config PORT1_DISABLED
  bool "Disabled"

config PORT1_FC
  bool "Fibre Channel"

endchoice

# The two last ports can be configured as FC or Ethernet
choice PORT2
  bool "Port 2"
  default PORT2_DISABLED
  depends on SFP_PORTS

config PORT2_DISABLED
  bool "Disabled"

config PORT2_FC
  bool "Fibre Channel"
  depends on PORT1_FC

config PORT2_ETHERNET
  bool "Ethernet"
  depends on PORT0_FC
  select HAVE_ETHERNET
  help
    Enable Ethernet TX/RX bridging of Fibre Channel frames.
    This port will be connected to Port 0.

endchoice

choice PORT3
  bool "Port 3"
  default PORT3_DISABLED
  depends on SFP_PORTS

config PORT3_DISABLED
  bool "Disabled"

config PORT3_FC
  bool "Fibre Channel"
  depends on PORT2_FC

config PORT3_ETHERNET
  bool "Ethernet"
  depends on PORT1_FC
  select HAVE_ETHERNET
  help
    Enable Ethernet TX/RX bridging of Fibre Channel frames.
    This port will be connected to Port 1.

endchoice

config LOOPBACK_01
  bool "Loopback port 0 and port 1"
  depends on SFP_PORTS
  depends on PORT0_FC
  depends on PORT1_FC

config AGGRESSIVE_OPT
  bool "Optimize aggressively for performance when building"

config STP
  bool "Enable SignalTap analyzer"

config STP_PCIE_TLP
  depends on STP
  bool "Enable PCIe TLP instance"

config STP_FC_STREAM
  depends on STP
  bool "Enable FC stream instance"
```

## defconfig
```kconfig
CONFIG_FEJKON=y
CONFIG_SFP_PORTS=y
CONFIG_PORT0_FC=y
# CONFIG_PORT1_DISABLED is not set
CONFIG_PORT1_FC=y
CONFIG_PORT2_DISABLED=y
# CONFIG_PORT2_FC is not set
# CONFIG_PORT2_ETHERNET is not set
CONFIG_PORT3_DISABLED=y
# CONFIG_PORT3_ETHERNET is not set
CONFIG_LOOPBACK_01=y
CONFIG_AGGRESSIVE_OPT=y
CONFIG_STP=y
CONFIG_STP_PCIE_TLP_TX=y
CONFIG_STP_PCIE_TLP_RX=y
CONFIG_STP_PCIE_C2H=y
CONFIG_STP_FC_STREAM=y
```

## test/pcie-hip/Kconfig
```kconfig
config AVALON_MONITOR
  bool "Enable Avalon-MM monitor (requires coverage support in simulator)"
```
